## app/defconfig
```kconfig
CONFIG_APP_WIPE_STORAGE=y
CONFIG_NET_L2_ETHERNET=y
CONFIG_CLOCK_CONTROL=y
CONFIG_PINCTRL=y
CONFIG_GPIO=y
CONFIG_SYSTEM_WORKQUEUE_STACK_SIZE=4096
CONFIG_MAIN_STACK_SIZE=2048
CONFIG_COUNTER=y
# CONFIG_TM1638 is not set
CONFIG_MATIEC=y
CONFIG_GENERATED=y
CONFIG_UDYNLINK=y
CONFIG_USE_SEGGER_RTT=y
CONFIG_ZCBOR=y
CONFIG_SOC_SERIES_STM32F4X=y
CONFIG_SOC_STM32F407XE=y
CONFIG_CORTEX_M_DEBUG_MONITOR_HOOK=y
CONFIG_INIT_STACKS=y
CONFIG_HEAP_MEM_POOL_SIZE=2048
CONFIG_THREAD_LOCAL_STORAGE=y
CONFIG_CONSOLE=y
CONFIG_UART_CONSOLE=y
CONFIG_COUNTER_LOG_LEVEL_ERR=y
CONFIG_ENTROPY_STM32_THR_THRESHOLD=4
CONFIG_ENTROPY_STM32_ISR_THRESHOLD=12
CONFIG_ETH_STM32_HAL_PHY_ADDRESS=1
CONFIG_I2C=y
CONFIG_RTC=y
CONFIG_RTC_LOG_LEVEL_ERR=y
CONFIG_RTC_STM32=y
CONFIG_UART_LINE_CTRL=y
CONFIG_MINIMAL_LIBC=y
CONFIG_COMMON_LIBC_MALLOC_ARENA_SIZE=-1
CONFIG_POSIX_API=y
CONFIG_BASE64=y
CONFIG_CONSOLE_SUBSYS=y
CONFIG_CONSOLE_GETCHAR=y
CONFIG_CONSOLE_GETCHAR_BUFSIZE=128
CONFIG_CONSOLE_PUTCHAR_BUFSIZE=128
CONFIG_SEGGER_DEBUGMON=y
CONFIG_FILE_SYSTEM_SHELL=y
CONFIG_FILE_SYSTEM_SHELL_TEST_COMMANDS=y
CONFIG_FILE_SYSTEM_MKFS=y
CONFIG_FS_FATFS_EXFAT=y
CONFIG_FS_FATFS_LFN_MODE_STACK=y
CONFIG_FS_FATFS_REENTRANT=y
CONFIG_FILE_SYSTEM_LITTLEFS=y
CONFIG_LOG=y
CONFIG_LOG_MODE_IMMEDIATE=y
# CONFIG_LOG_RUNTIME_FILTERING is not set
CONFIG_LOG_DEFAULT_LEVEL=1
CONFIG_MCUMGR=y
CONFIG_MCUMGR_LOG_LEVEL_DBG=y
CONFIG_MCUMGR_GRP_FS=y
CONFIG_MCUMGR_GRP_FS_LOG_LEVEL_DBG=y
CONFIG_MCUMGR_GRP_OS=y
CONFIG_MCUMGR_GRP_ZBASIC=y
CONFIG_MCUMGR_TRANSPORT_LOG_LEVEL_DBG=y
CONFIG_MCUMGR_TRANSPORT_SHELL=y
CONFIG_MCUMGR_TRANSPORT_UART=y
CONFIG_NETWORKING=y
CONFIG_NET_SHELL=y
CONFIG_NET_TCP=y
CONFIG_SNTP=y
CONFIG_NET_CONFIG_INIT_TIMEOUT=3
CONFIG_NET_CONFIG_NEED_IPV4=y
CONFIG_NET_CONFIG_SETTINGS=y
CONFIG_NET_CONFIG_MY_IPV4_ADDR="192.168.1.137"
CONFIG_NET_CONFIG_MY_IPV4_GW="192.168.1.2"
CONFIG_NET_SOCKETS=y
CONFIG_NET_DHCPV4=y
CONFIG_NET_DHCPV4_OPTION_CALLBACKS=y
CONFIG_NET_CONNECTION_MANAGER=y
CONFIG_SHELL_CMDS_SELECT=y
# CONFIG_KERNEL_SHELL is not set
# CONFIG_DATE_SHELL is not set
CONFIG_USB_DEVICE_STACK=y
# CONFIG_COMPILER_FREESTANDING is not set
CONFIG_FORTIFY_SOURCE_COMPILE_TIME=y
```

## boards/arm/CORE103V/Kconfig.board
```kconfig
# STM32F103RCT6 Mini board configuration

# Copyright (c) 2020 WuhanStudio
# SPDX-License-Identifier: Apache-2.0

config BOARD_CORE103V
	bool "STM32F103VET6 Core Board"
	depends on SOC_STM32F103XE
```

## boards/arm/CORE103V/Kconfig.defconfig
```kconfig
config BOARD_PLC_STM32F407VE
	select SOC_STM32F407XE# STM32F103RCT6 Mini board configuration

# Copyright (c) 2020 WuhanStudio
# SPDX-License-Identifier: Apache-2.0

if BOARD_CORE103V

config BOARD
	default "CORE103V"

endif # BOARD_CORE103V
```

## boards/arm/PLC_STM32F407VE/Kconfig.PLC_STM32F407VE
```kconfig
# STM32F4DISCOVERY board configuration

# Copyright (c) 2016 Linaro Limited.
# SPDX-License-Identifier: Apache-2.0

config BOARD_STM32_F4VE
	bool "STM32F4 Development Board"
	depends on SOC_STM32F407XE
```

## boards/arm/PLC_STM32F407VE/PLC_STM32F407VE_defconfig
```kconfig
# SPDX-License-Identifier: Apache-2.0

# SOC Configuration
CONFIG_SOC_SERIES_STM32F4X=y
CONFIG_SOC_STM32F407XE=y

# Networking STM32 HAL Configuration
CONFIG_ETH_STM32_HAL=y
CONFIG_ETH_STM32_HAL_RX_THREAD_STACK_SIZE=2048
CONFIG_ETH_STM32_HAL_PHY_ADDRESS=1
CONFIG_ENTROPY_GENERATOR=y

# Enable Clocks
CONFIG_CLOCK_CONTROL=y

# enable pin controller
CONFIG_PINCTRL=y
```

## boards/arm/STM32_F4VE/Kconfig.defconfig
```kconfig
# STM32F4DISCOVERY board configuration

# Copyright (c) 2016 Linaro Limited.
# SPDX-License-Identifier: Apache-2.0

if BOARD_PLC_STM32F407VE

config BOARD
	default "BOARD_PLC_STM32F407VE"

endif # BOARD_PLC_STM32F407VE
```

## boards/arm/STM32_F4VE/STM32_F4VE_defconfig
```kconfig
# SPDX-License-Identifier: Apache-2.0

# SOC Configuration
CONFIG_SOC_SERIES_STM32F4X=y
CONFIG_SOC_STM32F407XE=y

# Networking W5500 Configuration
CONFIG_ETH_W5500=y

# Enable Clocks
CONFIG_CLOCK_CONTROL=y

# enable pin controller
CONFIG_PINCTRL=y
```

## west.yml
```yaml
# Copyright (c) 2021 Nordic Semiconductor ASA
# SPDX-License-Identifier: Apache-2.0
manifest:
  remotes:
    - name: zephyrproject-rtos
      url-base: https://github.com/zephyrproject-rtos

  projects:
    - name: zephyr
      remote: zephyrproject-rtos
      revision: v3.6.0
      import:
        name-allowlist:
          - cmsis
          - hal_stm32
          - littlefs
          - fatfs
          - mbedtls
          - erpc

    - name: erpc
      revision: erpc-zephyr
      url: https://github.com/nandibrenna/erpc
      path: modules/lib/erpc
```
