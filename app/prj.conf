## CMakeLists.txt
```
#-------------------------------------------------------------------------------
# Zephyr Application
#
# Copyright (c) 2021 Nordic Semiconductor ASA
# SPDX-License-Identifier: Apache-2.0
cmake_minimum_required(VERSION 3.13.1)
find_package(Zephyr REQUIRED HINTS $ENV{ZEPHYR_BASE})
project(app LANGUAGES C CXX)

# erpc target code
set(ERPC_IDL_DIR ${CMAKE_CURRENT_SOURCE_DIR}/erpc)
set(ERPC_IDL_FILE ${ERPC_IDL_DIR}/erpc_PLCObject.erpc)
set(ERPC_OUTPUT_DIR ${ERPC_IDL_DIR})
add_custom_command(
  OUTPUT "${ERPC_OUTPUT_DIR}/erpc_error_handler.cpp"
         "${ERPC_OUTPUT_DIR}/c_erpc_PLCObject_server.cpp"
		 "${ERPC_OUTPUT_DIR}/erpc_PLCObject_interface.cpp"
		 "${ERPC_OUTPUT_DIR}/erpc_PLCObject_server.cpp"
  COMMAND erpcgen -I "${ERPC_IDL_DIR}" -o "${ERPC_OUTPUT_DIR}" "${ERPC_IDL_FILE}"
  DEPENDS "${ERPC_IDL_FILE}"
  COMMENT "Generating eRPC code from ${ERPC_IDL_FILE}"
)

target_sources(app PRIVATE
				${ERPC_OUTPUT_DIR}/erpc_error_handler.cpp
				${ERPC_OUTPUT_DIR}/c_erpc_PLCObject_server.cpp
				${ERPC_OUTPUT_DIR}/erpc_PLCObject_interface.cpp
				${ERPC_OUTPUT_DIR}/erpc_PLCObject_server.cpp
				)
zephyr_include_directories(${ERPC_OUTPUT_DIR})

# udynlink
target_sources(app PRIVATE
				${CMAKE_CURRENT_SOURCE_DIR}/udynlink/udynlink.c
				)
zephyr_include_directories(
				${CMAKE_CURRENT_SOURCE_DIR}/udynlink
				)
target_compile_definitions(app PRIVATE UDYNLINK_SKIP_PROLOGUE)

# main app
FILE(GLOB app_sources ${CMAKE_CURRENT_SOURCE_DIR}/src/*.c*)
target_sources(app PRIVATE ${app_sources})
zephyr_include_directories(include)
```

## Kconfig
```
# Copyright (c) 2019 Peter Bigot Consulting, LLC
# SPDX-License-Identifier: Apache-2.0

mainmenu "Beremiz_RTE"
	menu "Beremiz RTE Configuration"

		choice
			prompt "IO Configuration (Test)"
			default IO_TEST_I2C_GPIO

		config IO_TEST_I2C_GPIO
			bool "GPIO I2C MCP23017"
			help
				GPIO via I2C on MCP23017
				Output B0..B7
				Input A0..A7
				Run_Led is on STM32 Port_E Pin_13

		config IO_TEST_STM32_GPIO
			bool "STM32 GPIO"
			help
				GPIO via STM32 GPIO 
				Out 0 is Port_E Pin_14
				Out 1 is Port_E Pin_15
				Run_Led is Port_E Pin_13

		endchoice

		menu "Utility Functions"	
			config SIMPLE_THREAD_STACK_MONITORING
				bool "Simple Thread Stack Monitoring"
				imply THREAD_NAME
				imply THREAD_RUNTIME_STATS
				imply THREAD_STACK_INFO
				imply DEBUG_THREAD_INFO
				imply THREAD_ANALYZER
				help
					Enables simple monitoring of the thread stack to detect
					overflows and other issues.

			config PLC_SHELL_COMMANDS
				bool "PLC Shell Commands"
				depends on SHELL
				help
					Adds specific shell commands for PLC configuration and
					control. Requires the shell component.
			
			config PLC_SHELL_TEST_COMMANDS
				bool "PLC Shell Test Commands"
				depends on PLC_SHELL_COMMANDS
				help
					Adds additional shell commands for testing purposes.
					Requires the activation of PLC Shell Commands.

		endmenu

		menu "udynlink"

			config UDYNLINK
				bool "UDYNLINK"
				default y
				help
					Enable UDYNLINK, dynamic linker for ARM Cortex-M
					see https://github.com/bogdanm/udynlink
					and https://github.com/kinsamanka/udynlink
				
				if UDYNLINK
					config UDYNLINK_BUFFER_SIZE
						int "UDYNLINK_BUFFER_SIZE"
						default 16384
						help
							Set the size of the buffer used by UDYNLINK

					module = UDYNLINK
					module-str = udynlink
					source "subsys/logging/Kconfig.template.log_config"
				endif # UDYNLINK
		endmenu
		
		menu "Storage"
			config APP_WIPE_STORAGE
				bool "Option to clear the flash area before mounting"
				default n
				help
					Use this to force an existing file system to be created.

			config APP_STORAGE_FLASH_LITTLEFS
				bool "Use FLASH disk and LittleFS"
				default y
				imply DISK_DRIVER_FLASH
				imply FILE_SYSTEM
				imply FILE_SYSTEM_LITTLEFS
			help
				Use external Flash memory and the LittleFS file system.

			config APP_STORAGE_SDCARD_FATFS
				bool "Use SD and FAT file system"
				imply DISK_DRIVER_SDMMC
				imply FILE_SYSTEM
				imply FAT_FILESYSTEM_ELM
			help
				Use SD card and FAT file system.
						
			if DISK_DRIVER_FLASH
				config FLASH_MAP
					default y
				config FLASH_PAGE_LAYOUT
					default y
				config FLASH_LOG_LEVEL
					default 3
			endif # DISK_DRIVER_FLASH
		endmenu
	endmenu
source "Kconfig.zephyr"
```

## prj.conf
```kconfig
# Basic Application & System Settings
CONFIG_BOOT_BANNER_STRING="Beremiz_4uC PLC Runtime"

CONFIG_APP_STORAGE_FLASH_LITTLEFS=n
CONFIG_APP_STORAGE_SDCARD_FATFS=y
CONFIG_IO_TEST_I2C_GPIO=n
CONFIG_IO_TEST_STM32_GPIO=y

CONFIG_APP_WIPE_STORAGE=n

CONFIG_UDYNLINK=y
CONFIG_UDYNLINK_BUFFER_SIZE=16384
CONFIG_UDYNLINK_LOG_LEVEL_ERR=y

CONFIG_SIMPLE_THREAD_STACK_MONITORING=y
CONFIG_PLC_SHELL_COMMANDS=y
CONFIG_PLC_SHELL_TEST_COMMANDS=y

# Posix & System
CONFIG_WATCHDOG=y
CONFIG_WDT_DISABLE_AT_BOOT=n
CONFIG_SYSTEM_WORKQUEUE_STACK_SIZE=2048
CONFIG_POSIX_API=y 
CONFIG_MAIN_STACK_SIZE=4096
CONFIG_HEAP_MEM_POOL_SIZE=24576
CONFIG_SYS_HEAP_RUNTIME_STATS=y
CONFIG_INIT_STACKS=y
CONFIG_COMMON_LIBC_MALLOC_ARENA_SIZE=1024
CONFIG_COMMON_LIBC_MALLOC=y
CONFIG_JSON_LIBRARY=y

# GPIO Configuration
CONFIG_GPIO=y
CONFIG_GPIO_STM32=y

# Memory Protection Unit (Disabled)
CONFIG_ARM_MPU=n

# Console & Logging Configuration
CONFIG_CONSOLE=y
CONFIG_UART_CONSOLE=y
CONFIG_EARLY_CONSOLE=n
CONFIG_STDOUT_CONSOLE=y
CONFIG_CONSOLE_HANDLER=y
CONFIG_CONSOLE_SUBSYS=y
CONFIG_CONSOLE_GETCHAR=y
CONFIG_CONSOLE_GETCHAR_BUFSIZE=128
CONFIG_CONSOLE_PUTCHAR_BUFSIZE=128

# Enhanced Logging Settings
CONFIG_LOG=y
CONFIG_LOG_BUFFER_SIZE=2048
CONFIG_LOG_MODE_IMMEDIATE=y
CONFIG_LOG_DEFAULT_LEVEL=1      
CONFIG_LOG_RUNTIME_FILTERING=y
CONFIG_LOG_PRINTK=y
CONFIG_LOG_BACKEND_UART=n
CONFIG_LOG_CMDS=y
CONFIG_LOG_CUSTOM_FORMAT_SUPPORT=y
CONFIG_NET_LOG=n
CONFIG_LOG_OUTPUT_FORMAT_CUSTOM_TIMESTAMP=y

# Shell Configuration
CONFIG_SHELL=y
CONFIG_SHELL_STACK_SIZE=4096
CONFIG_SHELL_LOG_BACKEND=y
CONFIG_SHELL_BACKEND_SERIAL=y
CONFIG_SHELL_BACKEND_DUMMY=n
CONFIG_SHELL_CMDS_SELECT=y
CONFIG_DEVICE_SHELL=n
CONFIG_DEVMEM_SHELL=n
CONFIG_SHELL_CMDS=n
CONFIG_SHELL_STATS=n
CONFIG_SETTINGS_SHELL=n

# Peripheral Configurations (Counter/RTC, UART, I2C)
# CONFIG_COUNTER=y
# CONFIG_COUNTER_LOG_LEVEL_ERR=y
CONFIG_RTC=y
CONFIG_RTC_STM32=y
CONFIG_POSIX_CLOCK=y
CONFIG_SERIAL=y
CONFIG_UART_USE_RUNTIME_CONFIGURE=y
CONFIG_UART_INTERRUPT_DRIVEN=y
CONFIG_I2C=y
CONFIG_I2C_GPIO=y

# Networking Configuration
CONFIG_NETWORKING=y
CONFIG_NET_L2_ETHERNET=y

CONFIG_NET_ARP=y
CONFIG_NET_IPV4=y
CONFIG_NET_IPV6=n
CONFIG_NET_UDP=y
CONFIG_NET_TCP=y
CONFIG_NET_SOCKETS=y

CONFIG_NET_CONNECTION_MANAGER=y
CONFIG_NET_MGMT=y
CONFIG_NET_MGMT_EVENT=y
CONFIG_NET_MGMT_EVENT_STACK_SIZE=2048

CONFIG_NET_MAX_CONN=12
CONFIG_NET_MAX_CONTEXTS=12

# Networking logging
CONFIG_NET_LOG=n
CONFIG_NET_BUF_VARIABLE_DATA_SIZE=y
CONFIG_NET_BUF_LOG_LEVEL_ERR=y
CONFIG_NET_L2_ETHERNET_LOG_LEVEL_ERR=y
CONFIG_NET_IF_LOG_LEVEL_ERR=y

# Networking Initialization
CONFIG_NET_CONFIG_SETTINGS=y
CONFIG_NET_CONFIG_NEED_IPV4=y
CONFIG_NET_CONFIG_INIT_TIMEOUT=5
CONFIG_NET_CONFIG_AUTO_INIT=n
CONFIG_NET_CONFIG_LOG_LEVEL_INF=y

# Static IP Configuration
CONFIG_NET_CONFIG_MY_IPV4_ADDR="192.168.1.136"
CONFIG_NET_CONFIG_MY_IPV4_GW="192.168.1.2"
CONFIG_NET_CONFIG_MY_IPV4_NETMASK="255.255.255.0"
CONFIG_DNS_SERVER1="8.8.8.8"
CONFIG_DNS_SERVER2=""

# DHCP Configuration
CONFIG_NET_DHCPV4=n
CONFIG_NET_DHCPV4_OPTION_CALLBACKS=n
CONFIG_NET_DHCPV4_LOG_LEVEL_INF=y

# DNS Configuration
CONFIG_DNS_RESOLVER=y
CONFIG_DNS_RESOLVER_MAX_SERVERS=2
CONFIG_DNS_SERVER_IP_ADDRESSES=y
CONFIG_DNS_NUM_CONCUR_QUERIES=5
CONFIG_DNS_RESOLVER_ADDITIONAL_BUF_CTR=5
CONFIG_DNS_RESOLVER_ADDITIONAL_QUERIES=2
CONFIG_DNS_SERVER_IP_ADDRESSES=y
CONFIG_DNS_RESOLVER_LOG_LEVEL_INF=y

# Hostname Configuration
CONFIG_NET_HOSTNAME_ENABLE=y
CONFIG_NET_HOSTNAME_UNIQUE=y
CONFIG_NET_HOSTNAME="Beremiz4uC"

# MDNS Configuration
CONFIG_MDNS_RESPONDER=y
CONFIG_DNS_SD=y
CONFIG_MDNS_RESPONDER_DNS_SD=y
CONFIG_MDNS_RESPONDER_LOG_LEVEL_INF=y

# SNTP Configuration
CONFIG_SNTP=y
CONFIG_NET_CONFIG_CLOCK_SNTP_INIT=y
CONFIG_NET_CONFIG_SNTP_INIT_SERVER="0.de.pool.ntp.org"
CONFIG_SNTP_LOG_LEVEL_INF=y

# SPI Flash Configuration
CONFIG_SPI=y
CONFIG_FLASH=y
CONFIG_FLASH_MAP=y
CONFIG_FLASH_PAGE_LAYOUT=y
CONFIG_FLASH_LOG_LEVEL_ERR=y

# Filesystem Configuration LittleFS
CONFIG_FILE_SYSTEM=y
CONFIG_FILE_SYSTEM_MKFS=y
CONFIG_FILE_SYSTEM_LITTLEFS=y
CONFIG_FS_LITTLEFS_FC_HEAP_SIZE=2048
CONFIG_FS_LITTLEFS_BLK_DEV=n
CONFIG_FS_LOG_LEVEL_ERR=y

# Filesystem Configuration FatFS
CONFIG_FILE_SYSTEM=y
CONFIG_FAT_FILESYSTEM_ELM=y
CONFIG_DISK_ACCESS=y
CONFIG_DISK_DRIVERS=y
CONFIG_DISK_DRIVER_SDMMC=y

# C++ Language Support
CONFIG_CPP=y
CONFIG_STD_CPP20=y
CONFIG_GLIBCXX_LIBCPP=y
CONFIG_NEWLIB_LIBC=y
CONFIG_POSIX_FS=y
CONFIG_REQUIRES_FULL_LIBCPP=y

# eRPC Framework
CONFIG_ERPC=y
CONFIG_ERPC_TRANSPORT_UART=n
CONFIG_ERPC_TRANSPORT_TCP=y
CONFIG_THREAD_CUSTOM_DATA=y

# Settings Subsystem
CONFIG_SETTINGS=y
CONFIG_SETTINGS_FILE=y
CONFIG_SETTINGS_FILE_PATH="/lfs:/plc/settings.ini"

# mbedtls
CONFIG_MBEDTLS=y
CONFIG_MBEDTLS_BUILTIN=y
CONFIG_MBEDTLS_ENABLE_HEAP=y
CONFIG_BASE64=y

# debugging
CONFIG_DEBUG=n
CONFIG_DEBUG_INFO=n
CONFIG_SEGGER_DEBUGMON=n
CONFIG_CORTEX_M_DEBUG_MONITOR_HOOK=n
CONFIG_DEBUG_INFO=n
```

## src/main.c
```c
/****************************************************************************
#  Project Name: Beremiz 4 uC                                               #
#  Author(s): nandibrenna                                                   #
#  Created: 2024-03-15                                                      #
#  ======================================================================== #
#  Copyright © 2024 nandibrenna                                             #
#                                                                           #
#  Licensed under the Apache License, Version 2.0 (the "License");          #
#  you may not use this file except in compliance with the License.         #
#  You may obtain a copy of the License at                                  #
#                                                                           #
#      http://www.apache.org/licenses/LICENSE-2.0                           #
#                                                                           #
#  Unless required by applicable law or agreed to in writing, software      #
#  distributed under the License is distributed on an "AS IS" BASIS,        #
#  WITHOUT WARRANTIES OR CONDITIONS OF ANY KIND, either express or          #
#  implied. See the License for the specific language governing             #
#  permissions and limitations under the License.                           #
#                                                                           #
****************************************************************************/

#include <zephyr/logging/log.h>
LOG_MODULE_REGISTER(main_app, LOG_LEVEL_DBG);

#include <string.h>
#include <time.h>
#include <fcntl.h>

#include <zephyr/kernel.h>
#include <zephyr/drivers/gpio.h>
#include <zephyr/drivers/hwinfo.h>
#include <zephyr/drivers/watchdog.h>
#include <zephyr/usb/usb_device.h>

#include "plc_loader.h"
#include "plc_settings.h"
#include "plc_usb.h"


/****************************************************************************************************************************/
/*		devicetree																											*/
/****************************************************************************************************************************/
#define LED0_NODE DT_ALIAS(led0)
#define LED1_NODE DT_ALIAS(led1)
#define LED2_NODE DT_ALIAS(led2)
const struct gpio_dt_spec led0 = GPIO_DT_SPEC_GET(LED0_NODE, gpios);
const struct gpio_dt_spec led1 = GPIO_DT_SPEC_GET(LED1_NODE, gpios);
const struct gpio_dt_spec led2 = GPIO_DT_SPEC_GET(LED2_NODE, gpios);

#define SW1_NODE DT_ALIAS(sw1)
static const struct gpio_dt_spec button1 = GPIO_DT_SPEC_GET_OR(SW1_NODE, gpios, {0});
static struct gpio_callback button1_cb_data;

#define SW2_NODE DT_ALIAS(sw2)
static const struct gpio_dt_spec button2 = GPIO_DT_SPEC_GET_OR(SW2_NODE, gpios, {0});
static struct gpio_callback button2_cb_data;

#define WDT_MAX_WINDOW 2000U
#define WDT_MIN_WINDOW 0U
#define WDT_OPT WDT_OPT_PAUSE_HALTED_BY_DBG

#define SLEEP_TIME_MS 500

uint32_t allow_autostart = 1;

void button1_pressed(const struct device *dev, struct gpio_callback *cb, uint32_t pins) { return; }

void button2_pressed(const struct device *dev, struct gpio_callback *cb, uint32_t pins) { return; }

int main(void)
{
	uint32_t cause = 0;
	hwinfo_get_reset_cause(&cause);
	hwinfo_clear_reset_cause();
	if (cause == (RESET_WATCHDOG | RESET_PIN))
	{
		LOG_ERR("The watchdog has been triggered! The autostart of the PLC has been inhibited. To re-enable autostart, please reactivate it in the settings.");
		set_plc_autostart_setting(false);
	}

#if !(IS_ENABLED(CONFIG_QEMU))
	int err;
	int wdt_channel_id;
	const struct device *const wdt = DEVICE_DT_GET(DT_ALIAS(watchdog0));
	if (!device_is_ready(wdt))
	{
		LOG_ERR("%s: device not ready.", wdt->name);
		return 0;
	}

	struct wdt_timeout_cfg wdt_config = {
		.flags = WDT_FLAG_RESET_SOC,
		.window.min = WDT_MIN_WINDOW,
		.window.max = WDT_MAX_WINDOW,
	};

	wdt_channel_id = wdt_install_timeout(wdt, &wdt_config);
	if (wdt_channel_id < 0)
	{
		LOG_ERR("Watchdog install error channel=%d %d %s", wdt_channel_id, errno, strerror(errno));
		return 0;
	}

	err = 0; // wdt_setup(wdt, WDT_OPT);
	if (err < 0)
	{
		LOG_ERR("Watchdog setup error %d %d %s", err, errno, strerror(errno));
		return 0;
	}
#endif

	gpio_pin_configure_dt(&button1, GPIO_INPUT);
	gpio_pin_interrupt_configure_dt(&button1, GPIO_INT_EDGE_TO_ACTIVE);
	gpio_init_callback(&button1_cb_data, button1_pressed, BIT(button1.pin));
	gpio_add_callback(button1.port, &button1_cb_data);
	LOG_INF("Set up button1 at %s pin %d", button1.port->name, button1.pin);

	gpio_pin_configure_dt(&button2, GPIO_INPUT);
	gpio_pin_interrupt_configure_dt(&button2, GPIO_INT_EDGE_TO_ACTIVE);
	gpio_init_callback(&button2_cb_data, button2_pressed, BIT(button2.pin));
	gpio_add_callback(button2.port, &button2_cb_data);
	LOG_INF("Set up button2 at %s pin %d", button2.port->name, button2.pin);

	// LED configuration
	gpio_pin_configure_dt(&led0, GPIO_OUTPUT_INACTIVE);
	gpio_pin_configure_dt(&led1, GPIO_OUTPUT_INACTIVE);
	gpio_pin_configure_dt(&led2, GPIO_OUTPUT_INACTIVE);

	// USB CDC UART
	if (IS_ENABLED(CONFIG_USB_DEVICE_STACK))
	{
		int rc = usb_enable(NULL);
		if (rc != 0 && rc != -EALREADY)
		{
			LOG_ERR("Failed to enable USB");
			return 0;
		}
	}

	// USB MASS STORAGE
	if (IS_ENABLED(CONFIG_USB_DEVICE_STACK_NEXT))
	{
		int ret = enable_usb_device_next();
		if (ret != 0)
		{
			LOG_ERR("Failed to enable USB");
			return 0;
		}
		else
			LOG_INF("The device is put in USB mass storage mode.");
	}

	for (;;)
	{
		k_msleep(SLEEP_TIME_MS);
		wdt_feed(wdt, wdt_channel_id);
		gpio_pin_set_dt(&led0, plc_get_state());	// PLC state
	}

	LOG_INF("exit main");
	return 0;
}

/****************************************************************************************************************************************
 * @brief    Wrapper function for the Zephyr open function to be used in projects where direct usage of open is not feasible due to 
 *           namespace conflicts or when integrating with libraries expecting an _open function signature.
 * 
 * @param    name The pathname of the file.
 * @param    flags Flags that control how the file should be opened.
 * @return   Returns a file descriptor on success, or -1 on failure.
 ****************************************************************************************************************************************/
int open_wrapper(const char *name, int flags, ...) 
{
    va_list args;
    va_start(args, flags);
    int result = open(name, flags);
    va_end(args);
    return result;
}
int _open(const char *name, int flags, ...) __attribute__((alias("open_wrapper")));
```

## include/config.h
```c
/****************************************************************************
#  Project Name: Beremiz 4 uC                                               #
#  Author(s): nandibrenna                                                   #
#  Created: 2024-03-15                                                      #
#  ======================================================================== #
#  Copyright © 2024 nandibrenna                                             #
#                                                                           #
#  Licensed under the Apache License, Version 2.0 (the "License");          #
#  you may not use this file except in compliance with the License.         #
#  You may obtain a copy of the License at                                  #
#                                                                           #
#      http://www.apache.org/licenses/LICENSE-2.0                           #
#                                                                           #
#  Unless required by applicable law or agreed to in writing, software      #
#  distributed under the License is distributed on an "AS IS" BASIS,        #
#  WITHOUT WARRANTIES OR CONDITIONS OF ANY KIND, either express or          #
#  implied. See the License for the specific language governing             #
#  permissions and limitations under the License.                           #
#                                                                           #
****************************************************************************/

#ifndef CONFIG_H
#define CONFIG_H

/*****************************************************************************************************************************/
/*											common configuration			 											     */
/*****************************************************************************************************************************/
// littlefs doesnt support directories
#define FILESYSTEM_PATH					"/lfs:/"										// filesystem root
#define TMP_PATH						"tmp/"											// path for temporary files
#define PLC_PATH						"plc/"											// path for plc files
#define LOG_PATH						"log/"											// path for log files
#define WEB_PATH						"www/"											// path for www files
#define PLC_ID							"AAA"
#define PLC_PSK							"BBB"
#define PLC_TASK_STARTUP_DELAY			100
#define PLC_LOADER_STARTUP_DELAY		200
#define RPC_SERVER_STARTUP_DELAY		100
#define HTTP_SERVER_STARTUP_DELAY		200
#define HTTP_SERVER_PORT 				80
#define HTTP_ROOT						FILESYSTEM_PATH WEB_PATH

#define SNTP_SERVER 					"0.de.pool.ntp.org"
#define SNTP_TIMEOUT 					SYS_FOREVER_MS								// MSEC_PER_SEC * 30

#define ERPC_SERVER_PORT				1042
#define HOSTNAME						"Beremiz4uC"	
/*****************************************************************************************************************************/
/*									Configuration file paths											     				 */
/*****************************************************************************************************************************/
#define PLC_MD5_FILE					FILESYSTEM_PATH PLC_PATH "md5.txt"			// plc md5 file
#define PLC_BIN_FILE					FILESYSTEM_PATH PLC_PATH "plc.bin"			// plc module file
#define PLC_STARTUP_FILE				FILESYSTEM_PATH PLC_PATH "startup.scr"		// plc startup script
#define TMP_FILE_PATH 					FILESYSTEM_PATH TMP_PATH					// path for temporary files
#define PLC_ROOT_PATH					FILESYSTEM_PATH PLC_PATH					// path for plc files

#define TMP_FILE_EXTENSION 				".tmp"										// extension for temporary files

#define MAX_FILE_UPLOADS 				20
#define MAX_FILENAME_LENGTH 			8

/*****************************************************************************************************************************/
/*									Configuration rte logging															     */
/*****************************************************************************************************************************/
#define LOG_LEVELS 						4                              				// Number of supported log levels
#define RTE_LOGLEVEL_CRITICAL			0
#define RTE_LOGLEVEL_WARNING			1
#define RTE_LOGLEVEL_INFO				2
#define RTE_LOGLEVEL_DEBUG				3

#define MAX_LOG_MESSAGE_SIZE 			1024                 						// Maximum size of a log message
#define BACKUP_PERIOD_SEC 				0											// Backup log state every x seconds, 0 to disable
#define LOG_FILE_NAME 					FILESYSTEM_PATH LOG_PATH "plc.log"			// Logfile name
#define STATE_FILE_NAME 				FILESYSTEM_PATH LOG_PATH "logstate.log"		// Name of log state file


/*****************************************************************************************************************************/
/*									Configuration rte debugging															     */
/*****************************************************************************************************************************/

#define TRACE_SAMPLE_BUFFER_SIZE 		8192										// TraceSample Buffer Size for ringbuffer

// Configuration for the maximum count of traceable and forcible variables
#define TRACE_VARS_MAX_COUNT 			64											// Maximum number of variables to trace
#define FORCE_VARS_MAX_COUNT 			64											// Maximum number of variables to force
#define DEBUG_TIMEOUT 					(3 * MSEC_PER_SEC)							// Debug timeout in milliseconds

/*****************************************************************************************************************************/
#define NUM(a) (sizeof(a) / sizeof(*a))
#define ct_assert(e) ((void)sizeof(char[1 - 2*!(e)]))

#ifndef HOLDING_REG_COUNT
#define HOLDING_REG_COUNT       16
#endif

#ifndef INPUT_REG_COUNT
#define INPUT_REG_COUNT         8
#endif

#ifndef COIL_COUNT
#define COIL_COUNT              16
#endif

#ifndef DISCRETE_COUNT
#define DISCRETE_COUNT          16
#endif

#ifdef SLAVE_HOLDING_REG_COUNT
#undef SLAVE_HOLDING_REG_COUNT
#endif

#ifdef SLAVE_INPUT_REG_COUNT
#undef SLAVE_INPUT_REG_COUNT
#endif

#ifdef SLAVE_COIL_COUNT
#undef SLAVE_COIL_COUNT
#endif

#ifdef SLAVE_DISCRETE_COUNT
#undef SLAVE_DISCRETE_COUNT
#endif

#define SLAVE_HOLDING_REG_COUNT 0
#define SLAVE_INPUT_REG_COUNT   0
#define SLAVE_COIL_COUNT        0
#define SLAVE_DISCRETE_COUNT    0

#define QW_BASE                 0
#define IW_BASE                 0
#define QX_BASE                 0
#define IX_BASE                 0

#define QW_COUNT                (HOLDING_REG_COUNT + SLAVE_HOLDING_REG_COUNT)
#define IW_COUNT                (INPUT_REG_COUNT + SLAVE_INPUT_REG_COUNT)
#define QX_COUNT                (COIL_COUNT + SLAVE_COIL_COUNT)
#define IX_COUNT                (DISCRETE_COUNT + SLAVE_DISCRETE_COUNT)

#define CONFIG_MODBUS_PORT       502
#define CONFIG_RPC_PORT 		1042
#endif


#define K_THREAD_DEFINE_CCM(name, stack_size,                   \
			entry, p1, p2, p3,                                  \
			prio, options, delay)                               \
		Z_KERNEL_STACK_DEFINE_IN(_k_thread_stack_##name, stack_size, __ccm_noinit_section);	\
		Z_THREAD_COMMON_DEFINE(name, stack_size, entry, p1, p2, p3,	\
			       prio, options, delay)
```

## include/plc_debug.h
```c
/****************************************************************************
#  Project Name: Beremiz 4 uC                                               #
#  Author(s): nandibrenna                                                   #
#  Created: 2024-03-15                                                      #
#  ======================================================================== #
#  Copyright © 2024 nandibrenna                                             #
#                                                                           #
#  Licensed under the Apache License, Version 2.0 (the "License");          #
#  you may not use this file except in compliance with the License.         #
#  You may obtain a copy of the License at                                  #
#                                                                           #
#      http://www.apache.org/licenses/LICENSE-2.0                           #
#                                                                           #
#  Unless required by applicable law or agreed to in writing, software      #
#  distributed under the License is distributed on an "AS IS" BASIS,        #
#  WITHOUT WARRANTIES OR CONDITIONS OF ANY KIND, either express or          #
#  implied. See the License for the specific language governing             #
#  permissions and limitations under the License.                           #
#                                                                           #
****************************************************************************/

#ifndef PLC_DEBUG_H
#define PLC_DEBUG_H
#include "erpc_PLCObject_common.h"

// uint32_t get_current_memory_usage();
// void deinitialize_trace_variables();
// void initialize_trace_variables(TraceVariables *traces);
// void remove_trace_sample(uint32_t index);
// void add_trace_sample(uint32_t tick, uint8_t *data, uint32_t dataLength);
// void FreeDebugData(void);
// int WaitDebugData(uint32_t *tick);
// void InitiateDebugTransfer(void);
// int TryEnterDebugSection(void);
// void LeaveDebugSection(void);
// int suspendDebug(int disable);
// void resumeDebug(void);
// int TracesSwap(bool swap);
PLCstatus_enum get_PLCStatus(void);
void plc_debug_thread(void *, void *, void *);


void __init_debug    (void);
void __cleanup_debug (void);
void __retrieve_debug(void);
int publish_debug (void);

#endif
```

## include/plc_filesys.h
```c
/****************************************************************************
#  Project Name: Beremiz 4 uC                                               #
#  Author(s): nandibrenna                                                   #
#  Created: 2024-03-15                                                      #
#  ======================================================================== #
#  Copyright © 2024 nandibrenna                                             #
#                                                                           #
#  Licensed under the Apache License, Version 2.0 (the "License");          #
#  you may not use this file except in compliance with the License.         #
#  You may obtain a copy of the License at                                  #
#                                                                           #
#      http://www.apache.org/licenses/LICENSE-2.0                           #
#                                                                           #
#  Unless required by applicable law or agreed to in writing, software      #
#  distributed under the License is distributed on an "AS IS" BASIS,        #
#  WITHOUT WARRANTIES OR CONDITIONS OF ANY KIND, either express or          #
#  implied. See the License for the specific language governing             #
#  permissions and limitations under the License.                           #
#                                                                           #
****************************************************************************/

#ifndef PLC_FILESYS_H
#define PLC_FILESYS_H

void init_plc_filesys(void);
int lsdir(const char *path);
void unmount_sd_fatfs(void);
void mount_sd_fatfs(void);
int check_and_create_file(const char *filepath);
int check_and_create_path(const char *path);
#endif
```

## include/plc_http.h
```c
/****************************************************************************
#  Project Name: Beremiz 4 uC                                               #
#  Author(s): nandibrenna                                                   #
#  Created: 2024-03-15                                                      #
#  ======================================================================== #
#  Copyright © 2024 nandibrenna                                             #
#                                                                           #
#  Licensed under the Apache License, Version 2.0 (the "License");          #
#  you may not use this file except in compliance with the License.         #
#  You may obtain a copy of the License at                                  #
#                                                                           #
#      http://www.apache.org/licenses/LICENSE-2.0                           #
#                                                                           #
#  Unless required by applicable law or agreed to in writing, software      #
#  distributed under the License is distributed on an "AS IS" BASIS,        #
#  WITHOUT WARRANTIES OR CONDITIONS OF ANY KIND, either express or          #
#  implied. See the License for the specific language governing             #
#  permissions and limitations under the License.                           #
#                                                                           #
****************************************************************************/

#ifndef PLC_HTTP_H
#define PLC_HTTP_H

#include <unistd.h>

void send_status_update();
void handle_status_request(int client_fd);
void process_websocket_handshake(int client_fd, const char *client_key);
void send_ping_frame(int client_fd);
void send_pong_frame(int client_fd);
void send_close_frame(int client_fd);
void send_websocket_message(int client_fd, const char *message);
void parse_websocket_frame(unsigned char *frame, size_t frame_size, int client_fd);
void handle_websocket_communication(int client_fd);
bool is_websocket_upgrade_request(const char *request);
const char *extract_websocket_key(const char *request);
const char *get_content_type(const char *file_path);
void send_file(int client_fd, const char *file_path);
void plc_websocket_server(void *client_fd, void *arg2, void *arg3);
void process_request(int client_fd);
void plc_http_server(void *, void *, void *);

char *strcasestr(const char *haystack, const char *needle);

#endif
```

## include/plc_io.h
```c
/****************************************************************************
#  Project Name: Beremiz 4 uC                                               #
#  Author(s): nandibrenna                                                   #
#  Created: 2024-03-15                                                      #
#  ======================================================================== #
#  Copyright © 2024 nandibrenna                                             #
#                                                                           #
#  Licensed under the Apache License, Version 2.0 (the "License");          #
#  you may not use this file except in compliance with the License.         #
#  You may obtain a copy of the License at                                  #
#                                                                           #
#      http://www.apache.org/licenses/LICENSE-2.0                           #
#                                                                           #
#  Unless required by applicable law or agreed to in writing, software      #
#  distributed under the License is distributed on an "AS IS" BASIS,        #
#  WITHOUT WARRANTIES OR CONDITIONS OF ANY KIND, either express or          #
#  implied. See the License for the specific language governing             #
#  permissions and limitations under the License.                           #
#                                                                           #
****************************************************************************/

#ifndef PLC_IO_H
#define PLC_IO_H
// Define the IO pins

void plc_init_io(void);
void plc_update_inputs(void);
void plc_update_outputs(bool plc_run);

#endif
```

## include/plc_loader.h
```c
/****************************************************************************
#  Project Name: Beremiz 4 uC                                               #
#  Author(s): nandibrenna                                                   #
#  Created: 2024-03-15                                                      #
#  ======================================================================== #
#  Copyright © 2024 nandibrenna                                             #
#                                                                           #
#  Licensed under the Apache License, Version 2.0 (the "License");          #
#  you may not use this file except in compliance with the License.         #
#  You may obtain a copy of the License at                                  #
#                                                                           #
#      http://www.apache.org/licenses/LICENSE-2.0                           #
#                                                                           #
#  Unless required by applicable law or agreed to in writing, software      #
#  distributed under the License is distributed on an "AS IS" BASIS,        #
#  WITHOUT WARRANTIES OR CONDITIONS OF ANY KIND, either express or          #
#  implied. See the License for the specific language governing             #
#  permissions and limitations under the License.                           #
#                                                                           #
****************************************************************************/

#ifndef PLC_LOADER_H
#define PLC_LOADER_H
typedef unsigned int dbgvardsc_index_t;
#include "udynlink.h"

// RTE Functions
void config_init__(void);
void config_run__(unsigned long);
int GetDebugVariable(dbgvardsc_index_t idx, void *value, size_t *size);
int RegisterDebugVariable(dbgvardsc_index_t idx, void *forced, size_t *size);
size_t get_var_size(size_t idx);
void force_var(size_t idx, bool forced, void *val);
void set_trace(size_t idx, bool trace, void *val);
void trace_reset(void);

void plc_set_start(void);
void plc_set_stop(void);
int plc_get_state(void);
int plc_get_loader_state(void);
int erase_plc_programm_flash(int state);
void reload_plc(void);
int load_plc_module(char *filename);
int unload_plc_module(void);

extern uint32_t plc_initialized;
extern uint32_t plc_run;
extern udynlink_module_t mod;
#endif
```

## include/plc_log_rte.h
```c
/****************************************************************************
#  Project Name: Beremiz 4 uC                                               #
#  Author(s): nandibrenna                                                   #
#  Created: 2024-03-15                                                      #
#  ======================================================================== #
#  Copyright © 2024 nandibrenna                                             #
#                                                                           #
#  Licensed under the Apache License, Version 2.0 (the "License");          #
#  you may not use this file except in compliance with the License.         #
#  You may obtain a copy of the License at                                  #
#                                                                           #
#      http://www.apache.org/licenses/LICENSE-2.0                           #
#                                                                           #
#  Unless required by applicable law or agreed to in writing, software      #
#  distributed under the License is distributed on an "AS IS" BASIS,        #
#  WITHOUT WARRANTIES OR CONDITIONS OF ANY KIND, either express or          #
#  implied. See the License for the specific language governing             #
#  permissions and limitations under the License.                           #
#                                                                           #
****************************************************************************/

#ifndef PLC_LOG_RTE_H
#define PLC_LOG_RTE_H
#include "erpc_PLCObject_common.h"

// helper functions
void initialize_logging(void);
void deinitialize_logging(void);
void backup_logging(void);
void LoadLogState(uint32_t *logCounts);
void SaveLogState(uint32_t *logCounts);
void logging_timer_callback(struct k_timer *timer_id);

// erpc functions
uint32_t GetLogCount(uint8_t level);
uint32_t ResetLogCount(void);
uint32_t GetLogMessage(uint8_t level, uint32_t msgID, log_message *message);

// rte function
int LogMessage(uint8_t level, char* buf, int8_t size);

// rte function to log in zephyr
void rte_log_inf(const char* fmt, ...);

#endif
```

## include/plc_network.h
```c
/****************************************************************************
#  Project Name: Beremiz 4 uC                                               #
#  Author(s): nandibrenna                                                   #
#  Created: 2024-03-15                                                      #
#  ======================================================================== #
#  Copyright © 2024 nandibrenna                                             #
#                                                                           #
#  Licensed under the Apache License, Version 2.0 (the "License");          #
#  you may not use this file except in compliance with the License.         #
#  You may obtain a copy of the License at                                  #
#                                                                           #
#      http://www.apache.org/licenses/LICENSE-2.0                           #
#                                                                           #
#  Unless required by applicable law or agreed to in writing, software      #
#  distributed under the License is distributed on an "AS IS" BASIS,        #
#  WITHOUT WARRANTIES OR CONDITIONS OF ANY KIND, either express or          #
#  implied. See the License for the specific language governing             #
#  permissions and limitations under the License.                           #
#                                                                           #
****************************************************************************/

#ifndef NET_IF_H
#define NET_IF_H
void network_init(void);
void sync_clock_via_sntp(void);

#endif
```

## include/plc_rpc.h
```c
/****************************************************************************
#  Project Name: Beremiz 4 uC                                               #
#  Author(s): nandibrenna                                                   #
#  Created: 2024-03-15                                                      #
#  ======================================================================== #
#  Copyright © 2024 nandibrenna                                             #
#                                                                           #
#  Licensed under the Apache License, Version 2.0 (the "License");          #
#  you may not use this file except in compliance with the License.         #
#  You may obtain a copy of the License at                                  #
#                                                                           #
#      http://www.apache.org/licenses/LICENSE-2.0                           #
#                                                                           #
#  Unless required by applicable law or agreed to in writing, software      #
#  distributed under the License is distributed on an "AS IS" BASIS,        #
#  WITHOUT WARRANTIES OR CONDITIONS OF ANY KIND, either express or          #
#  implied. See the License for the specific language governing             #
#  permissions and limitations under the License.                           #
#                                                                           #
****************************************************************************/


#ifndef PLC_RPC_H
#define PLC_RPC_H

char *print_hash(const uint8_t hash[16]);
void add_file_upload(char *filename, struct binary_t *blobID, FILE *file_pointer);
void update_last_blobID(const struct binary_t *blobID);
char* get_filename_from_blobID(const struct binary_t *blobID);
FILE* get_file_pointer_from_blobID(const struct binary_t *blobID);
struct blob_t get_last_blobID();
FILE* is_last_file_pointer_valid();
char *generate_random_filename(char *file_name, char *path);
binary_t blob_to_binary(struct blob_t blob);
uint32_t finish_fileUpload(const binary_t *blobID);
void update_fileUpload(binary_t *blobID);
uint32_t prepare_fileUpload(binary_t *blobID);
bool path_exists(const char *path);
int rmdir(const char *path);
void rpc_server_task(void *, void *, void *);

struct blob_t
{
    uint8_t data[33];
    uint32_t dataLength;
};

struct file_upload
{
    char filename[33];
    struct blob_t blobID;
    FILE *file_pointer;
};
#endif
```

## include/plc_settings.h
```c
/****************************************************************************
#  Project Name: Beremiz 4 uC                                               #
#  Author(s): nandibrenna                                                   #
#  Created: 2024-03-15                                                      #
#  ======================================================================== #
#  Copyright © 2024 nandibrenna                                             #
#                                                                           #
#  Licensed under the Apache License, Version 2.0 (the "License");          #
#  you may not use this file except in compliance with the License.         #
#  You may obtain a copy of the License at                                  #
#                                                                           #
#      http://www.apache.org/licenses/LICENSE-2.0                           #
#                                                                           #
#  Unless required by applicable law or agreed to in writing, software      #
#  distributed under the License is distributed on an "AS IS" BASIS,        #
#  WITHOUT WARRANTIES OR CONDITIONS OF ANY KIND, either express or          #
#  implied. See the License for the specific language governing             #
#  permissions and limitations under the License.                           #
#                                                                           #
****************************************************************************/

#ifndef PLC_SETTINGS_H
#define PLC_SETTINGS_H

#include <stdbool.h>

#ifdef __cplusplus
extern "C" {
#endif

// Initialisierungsfunktion
void plc_settings_init(void);
void plc_settings_load(void);
void plc_settings_save(void);

// Getter und Setter für die Einstellungen
bool get_mount_sd_card_setting(void);
void set_mount_sd_card_setting(bool value);

bool get_plc_autostart_setting(void);
void set_plc_autostart_setting(bool value);

bool get_plc_autostart_source_setting(void) ;
void set_plc_autostart_setting(bool value);

char* get_hostname_setting(void);
void set_hostname_setting(const char* value);

bool get_dhcp_active_setting(void);
void set_dhcp_active_setting(bool value);

int get_dhcp_timeout_sec_setting(void);
void set_dhcp_timeout_sec_setting(int value);

bool get_fallback_ip_setting(void);
void set_fallback_ip_setting(bool value);

char* get_ip_address_setting(void);
void set_ip_address_setting(const char* value);

char* get_netmask_setting(void);
void set_netmask_setting(const char* value);

char* get_gateway_setting(void);
void set_gateway_setting(const char* value);

char* get_mac_address_setting(void);
void set_mac_address_setting(const char* value);

bool get_ntp_server_setting(void);
void set_ntp_server_setting(bool value);

char* get_ntp_address_setting(void);
void set_ntp_address_setting(const char* value);

int get_ntp_timeout_setting(void);
void set_ntp_timeout_setting(int value);

int get_rpc_server_port_setting(void);
void set_rpc_server_port_setting(int value);

#ifdef __cplusplus
}
#endif

#endif // PLC_SETTINGS_H
```

## include/plc_task.h
```c
/****************************************************************************
#  Project Name: Beremiz 4 uC                                               #
#  Author(s): nandibrenna                                                   #
#  Created: 2024-03-15                                                      #
#  ======================================================================== #
#  Copyright © 2024 nandibrenna                                             #
#                                                                           #
#  Licensed under the Apache License, Version 2.0 (the "License");          #
#  you may not use this file except in compliance with the License.         #
#  You may obtain a copy of the License at                                  #
#                                                                           #
#      http://www.apache.org/licenses/LICENSE-2.0                           #
#                                                                           #
#  Unless required by applicable law or agreed to in writing, software      #
#  distributed under the License is distributed on an "AS IS" BASIS,        #
#  WITHOUT WARRANTIES OR CONDITIONS OF ANY KIND, either express or          #
#  implied. See the License for the specific language governing             #
#  permissions and limitations under the License.                           #
#                                                                           #
****************************************************************************/

#ifndef PLC_TASK_H
#define PLC_TASK_H

void plc_main_task(void *, void *, void *);
const char *plc_task_get_cycle_time(void);

extern uint32_t __tick;
extern uint64_t common_cycle_time;
#endif
```

## include/plc_time_rtc.h
```c
/****************************************************************************
#  Project Name: Beremiz 4 uC                                               #
#  Author(s): nandibrenna                                                   #
#  Created: 2024-03-15                                                      #
#  ======================================================================== #
#  Copyright © 2024 nandibrenna                                             #
#                                                                           #
#  Licensed under the Apache License, Version 2.0 (the "License");          #
#  you may not use this file except in compliance with the License.         #
#  You may obtain a copy of the License at                                  #
#                                                                           #
#      http://www.apache.org/licenses/LICENSE-2.0                           #
#                                                                           #
#  Unless required by applicable law or agreed to in writing, software      #
#  distributed under the License is distributed on an "AS IS" BASIS,        #
#  WITHOUT WARRANTIES OR CONDITIONS OF ANY KIND, either express or          #
#  implied. See the License for the specific language governing             #
#  permissions and limitations under the License.                           #
#                                                                           #
****************************************************************************/

#ifndef PLC_TIME_RTC_H
#define PLC_TIME_RTC_H
#include <zephyr/logging/log_output_custom.h>
#include <zephyr/logging/log_ctrl.h>

int log_ts_print(const struct log_output *output, const log_timestamp_t timestamp,
                 const log_timestamp_printer_t printer);

void set_system_time_from_rtc(void);
void set_rtc_from_system_time(void);
const char* get_time_str(void);

/****************************************************************************************************************************************
 * @brief    Represents time in seconds and nanoseconds for compatibility with 64-bit systems.
 *
 * @param    sec     Seconds since epoch, 64-bit for compatibility.
 * @param    nsec    Nanoseconds since the beginning of the last second, 64-bit for compatibility.
 * @return   None.
 ****************************************************************************************************************************************/
typedef struct
{
	uint64_t sec;  // Seconds since epoch, ensuring 64-bit compatibility
	uint64_t nsec; // Nanoseconds past the second, also 64-bit for compatibility
} TimeSpec64;


TimeSpec64 addTimeSpec64(TimeSpec64 t1, TimeSpec64 t2);

#endif
```
